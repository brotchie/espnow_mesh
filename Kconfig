## examples/basic_controller/sdkconfig.defaults
```kconfig
CONFIG_ESPNOW_MESH_ROLE_CONTROLLER=y
CONFIG_ESPNOW_MESH_CHANNEL=1
CONFIG_ESPNOW_MESH_SEND_RETRIES=5
CONFIG_ESPNOW_MESH_RETRY_INTERVAL_MS=120
CONFIG_ESPNOW_MESH_RELIABLE_MAX_ATTEMPTS=8
CONFIG_ESPNOW_MESH_RELIABLE_INITIAL_BACKOFF_MS=150
CONFIG_ESPNOW_MESH_RELIABLE_MAX_BACKOFF_MS=2000
CONFIG_ESPNOW_MESH_RELIABLE_RETRY_JITTER_MS=30
CONFIG_ESPNOW_MESH_RELIABLE_DEADLINE_MS=10000
CONFIG_ESPNOW_MESH_DATA_INTERVAL_MS=2000
CONFIG_ESPNOW_MESH_TIME_SYNC_INTERVAL_MS=5000
CONFIG_ESPNOW_MESH_TIME_SYNC_MAX_DELAY_US=30000
CONFIG_ESPNOW_MESH_TIME_SYNC_FILTER_SHIFT=3
CONFIG_ESPNOW_MESH_PAYLOAD_BYTES=64
CONFIG_ESPNOW_MESH_MAX_SATELLITES=8
CONFIG_ESPNOW_MESH_REGISTRATION_AP_ENABLE=y
CONFIG_ESPNOW_MESH_REGISTRATION_SSID="esp-now-mesh"
CONFIG_ESPNOW_MESH_REGISTRATION_PASSWORD="espnowmesh"
CONFIG_ESPNOW_MESH_REGISTRATION_MAX_CONNECTIONS=5
CONFIG_ESPNOW_MESH_REGISTRATION_LISTEN_MS=5000
CONFIG_ESPNOW_MESH_REGISTRATION_RETRY_INTERVAL_MS=15000
CONFIG_ESPNOW_MESH_REGISTRATION_SCAN_MS=300
CONFIG_ESPNOW_MESH_REGISTRATION_CONNECT_TIMEOUT_MS=10000
CONFIG_ESPNOW_MESH_REGISTRATION_HOLD_MS=1500
CONFIG_ESPNOW_MESH_EVENT_QUEUE_LEN=32
```

## examples/basic_satellite/sdkconfig.defaults
```kconfig
CONFIG_ESPNOW_MESH_ROLE_SATELLITE=y
CONFIG_ESPNOW_MESH_CHANNEL=1
CONFIG_ESPNOW_MESH_TIME_SYNC_INTERVAL_MS=5000
CONFIG_ESPNOW_MESH_TIME_SYNC_MAX_DELAY_US=30000
CONFIG_ESPNOW_MESH_TIME_SYNC_FILTER_SHIFT=3
CONFIG_ESPNOW_MESH_REGISTRATION_AP_ENABLE=y
CONFIG_ESPNOW_MESH_REGISTRATION_SSID="esp-now-mesh"
CONFIG_ESPNOW_MESH_REGISTRATION_PASSWORD="espnowmesh"
CONFIG_ESPNOW_MESH_REGISTRATION_MAX_CONNECTIONS=5
CONFIG_ESPNOW_MESH_REGISTRATION_LISTEN_MS=5000
CONFIG_ESPNOW_MESH_REGISTRATION_RETRY_INTERVAL_MS=15000
CONFIG_ESPNOW_MESH_REGISTRATION_SCAN_MS=300
CONFIG_ESPNOW_MESH_REGISTRATION_CONNECT_TIMEOUT_MS=10000
CONFIG_ESPNOW_MESH_REGISTRATION_HOLD_MS=1500
CONFIG_ESPNOW_MESH_EVENT_QUEUE_LEN=32
```
